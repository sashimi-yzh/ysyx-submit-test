SECTIONS {
  .data.extra : AT(LOADADDR(.data) + SIZEOF(.data)) {
    /* Symbols exported by RT-Thread's finsh shell. */
    __fsymtab_start = .;
    KEEP(*(FSymTab))
    __fsymtab_end = .;
    . = ALIGN(8);
    __vsymtab_start = .;
    KEEP(*(VSymTab))
    __vsymtab_end = .;
    . = ALIGN(8);
    /* RT-Thread automatic initialization table. */
    __rt_init_start = .;
    KEEP(*(SORT(.rti_fn*)))
    __rt_init_end = .;
    . = ALIGN(8);
    __rt_utest_tc_tab_start = .;
    KEEP(*(UtestTcTab))
    __rt_utest_tc_tab_end = .;
    . = ALIGN(8);
    /* Embedded Abstract Machine applications with initial contents. */
    __am_apps_data_start = .;
    *(__am_apps.data*)
    *(__am_apps.sdata*)
    __am_apps_data_end = .;
    . = ALIGN(8);
  } : data
  /* Extend the runtime copy range to include .data.extra. */
  _data_end = .;
}
INSERT AFTER .data;
SECTIONS {
  .bss.extra (NOLOAD) : {
    . = ALIGN(8);
    __am_apps_bss_start = .;
    *(__am_apps.bss*)
    *(__am_apps.sbss*)
    *(__am_apps.scommon*)
    __am_apps_bss_end = .;
    . = ALIGN(8);
  } : bss
}
INSERT BEFORE .bss;
