## nemu/configs/riscv32-am_defconfig
```kconfig
CONFIG_CC_O3=y
CONFIG_CC_DEBUG_ONLY_G=y
CONFIG_TAKE_RUN_AS_RUNBATCH=y
# CONFIG_TRACE is not set
CONFIG_PC_RESET_OFFSET=0x0
CONFIG_DEVICE=y
# CONFIG_HAS_AUDIO is not set
# CONFIG_HAS_DISK is not set
CONFIG_TIMER_CLOCK_GETTIME=y
```

## nemu/src/isa/riscv32/Kconfig
```kconfig
menu "ISA-dependent Options for riscv"

config RV64
  bool "64-bit RISC-V architecture"
  default n

config RVE
  bool "Use E extension"
  default n

menuconfig NPC
  bool "Use NPC"
  default n

if NPC

config NPC_WAVE
  bool "Generate wave file"
  default n

config NPC_PACKAGE_NAME
  string "Scala package name"
  default "sirius"

config NPC_TOP_NAME
  string "Top module name"
  default "Top"

config NPC_VERILATOR_GPR
  string "Verilator GPR"
  default "Top__DOT__getGprDpiC__DOT__temp_regs"

endif #NPC


endmenu
```

## nemu/src/memory/Kconfig
```kconfig
menu "Memory Configuration"

config MBASE
  hex "FLASH base address"
  default 0x0        if ISA_x86
  default 0x30000000
config MSIZE
  hex "FLASH size"
  default 0x1000000

config SBASE
  hex "SRAM base address"
  default 0x0f000000
config SSIZE
  hex "SRAM size"
  default 0x2000

config PSBASE
  hex "PSRAM base address"
  default 0x80000000
config PSSIZE
  hex "PSRAM size"
  default 0x400000

config SDBASE
  hex "SDRAM base address"
  default 0xa0000000
config SDSIZE
  hex "SDRAM size"
  default 0x2000000

config PC_RESET_OFFSET
  hex "Offset of reset vector from the base of memory"
  default 0x100000 if ISA_x86
  default 0

choice
  prompt "Physical memory definition"
  default PMEM_GARRAY
config PMEM_MALLOC
  bool "Using malloc()"
config PMEM_GARRAY
  depends on !TARGET_AM
  bool "Using global array"
endchoice

config MEM_RANDOM
  depends on MODE_SYSTEM && !DIFFTEST && !TARGET_AM
  bool "Initialize the memory with random values"
  default y
  help
    This may help to find undefined behaviors.

endmenu #MEMORY
```

## nemu/tools/nemu-diff/configs/riscv32-am_defconfig
```kconfig
CONFIG_RVE=y
CONFIG_TARGET_SHARE=y
CONFIG_CC_O3=y
CONFIG_CC_DEBUG_ONLY_G=y
# CONFIG_TRACE is not set
CONFIG_MSIZE=0x400000
# CONFIG_MEM_RANDOM is not set
CONFIG_DEVICE=y
# CONFIG_HAS_SERIAL is not set
# CONFIG_HAS_TIMER is not set
# CONFIG_HAS_KEYBOARD is not set
# CONFIG_HAS_VGA is not set
CONFIG_HAS_MROM=y
CONFIG_HAS_SRAM=y
CONFIG_HAS_FLASH=y
CONFIG_HAS_SDRAM=y
CONFIG_SDRAM_SIZE=0x08000000
# CONFIG_HAS_AUDIO is not set
# CONFIG_HAS_DISK is not set
CONFIG_TIMER_CLOCK_GETTIME=y
```

## npc/Kconfig
```kconfig
mainmenu "NPC Configuration Menu"

menu "Tracing Options"

config WAVE_DUMP
    bool "Enable wave dump"
    default y

config TRACE
    bool "Enable Tracer"
    default y
    help
        Enable Trace to help debug

if TRACE

config TRACE_START
    int "When tracing is enabled (unit: number of instructions)"
    default 0

config TRACE_END
    int "When tracing is disabled (unit: number of instructions)"
    default 10000

config MTRACE
    bool "Enable memory tracer"
    default n

config FTRACE
    bool "Enable function tracer"
    default n

config ETRACE
    bool "Enable exception tracer"
    default n

config ITRACE
    bool "Enable instruction tracer"
    default n

endif

config STATISTICS
    bool "Enable statistics tracer"
    default n

endmenu

menu "Device Options"

config DEVICE
    bool "Enable device support"
    default y
    help
        Enable MMIO device support for NPC.

if DEVICE

menuconfig HAS_SERIAL
    bool "Enable serial port (UART 16550)"
    default y

if HAS_SERIAL
config SERIAL_MMIO
    hex "MMIO base address of serial port"
    default 0x10000000
endif # HAS_SERIAL

menuconfig HAS_TIMER
    bool "Enable RTC timer"
    default y

if HAS_TIMER
config RTC_MMIO
    hex "MMIO base address of RTC timer"
    default 0x10000048
endif # HAS_TIMER

endif # DEVICE

endmenu

menu "Memory Configuration"

config PSRAM_BASE
    hex "PSRAM base address"
    default 0x80000000

config PSRAM_SIZE
    hex "PSRAM size"
    default 0x400000

config MROM_BASE
    hex "MROM base address"
    default 0x20000000

config MROM_SIZE
    hex "MROM size"
    default 0x1000

config SRAM_BASE
    hex "SRAM base address"
    default 0x0f000000

config SRAM_SIZE
    hex "SRAM size"
    default 0x2000

config FLASH_BASE
    hex "Flash base address"
    default 0x30000000

config FLASH_SIZE
    hex "Flash size"
    default 0x1000000

config SDRAM_BASE
    hex "SDRAM base address"
    default 0xa0000000

config SDRAM_SIZE
    hex "SDRAM size"
    default 0x2000000

endmenu

menu "Testing and Debugging"

config DIFFTEST
    bool "Enable differential testing"
    default n
    help
        Enable differential testing with NEMU.

config WATCHPOINT
    bool "Enable watchpoint support"
    default y

config BATCH_MODE
    bool "Enable batch mode"
    default y

endmenu
```

## npc/config/npc/configs/_defconfig
```kconfig
CONFIG_RVE=y
CONFIG_NPC=y
CONFIG_NPC_TOP_NAME="ysyx_26010008"
CONFIG_NPC_VERILATOR_GPR="ysyx_26010008__DOT__getGprDpiC__DOT__temp_regs"
CONFIG_CC_O3=y
CONFIG_CC_DEBUG_ONLY_G=y
CONFIG_TAKE_RUN_AS_RUNBATCH=y
# CONFIG_TRACE is not set
CONFIG_MSIZE=0x400000
CONFIG_DEVICE=y
CONFIG_SERIAL_MMIO=0x10000000
# CONFIG_HAS_TIMER is not set
CONFIG_I8042_DATA_MMIO=0x10000500
CONFIG_FB_ADDR=0x11000000
CONFIG_VGA_CTL_MMIO=0x10000100
# CONFIG_HAS_AUDIO is not set
# CONFIG_HAS_DISK is not set
CONFIG_NPC_SKIP_CLINT=y
# CONFIG_NPC_SKIP_UART is not set
CONFIG_TIMER_CLOCK_GETTIME=y
```

## npc/config/ysyxsoc/configs/_defconfig
```kconfig
CONFIG_RVE=y
CONFIG_NPC=y
CONFIG_NPC_TOP_NAME="ysyxSoCFull"
CONFIG_NPC_VERILATOR_GPR="ysyxSoCFull__DOT__asic__DOT__cpu__DOT__cpu__DOT__getGprDpiC__DOT__temp_regs"
CONFIG_CC_O3=y
CONFIG_CC_DEBUG_ONLY_G=y
CONFIG_TAKE_RUN_AS_RUNBATCH=y
# CONFIG_TRACE is not set
CONFIG_MSIZE=0x400000
CONFIG_DEVICE=y
# CONFIG_HAS_SERIAL is not set
# CONFIG_HAS_TIMER is not set
# CONFIG_HAS_KEYBOARD is not set
# CONFIG_HAS_VGA is not set
CONFIG_HAS_MROM=y
CONFIG_HAS_FLASH=y
CONFIG_HAS_SDRAM=y
CONFIG_SDRAM_SIZE=0x08000000
# CONFIG_HAS_AUDIO is not set
# CONFIG_HAS_DISK is not set
CONFIG_NPC_SKIP_CLINT=y
CONFIG_NPC_SKIP_SPI=y
CONFIG_NPC_SKIP_GPIO=y
CONFIG_NPC_SKIP_PS2=y
CONFIG_NPC_SKIP_VGA=y
CONFIG_NPC_SKIP_CHIPLINK_MEM=y
CONFIG_TIMER_CLOCK_GETTIME=y
CONFIG_NVBOARD=y
```
