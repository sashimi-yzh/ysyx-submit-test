## npc/csrc/device/Kconfig
```kconfig
menuconfig DEVICE
  bool "Devices"
  default n
  help
    Provide device support for NEMU.

if DEVICE

config HAS_PORT_IO
  bool
  default n

menuconfig HAS_SERIAL
  bool "Enable serial"
  default y

if HAS_SERIAL
config SERIAL_PORT
  depends on HAS_PORT_IO
  hex "Port address of the serial controller"
  default 0x3f8

config SERIAL_MMIO
  hex "MMIO address of the serial controller"
  default 0xa00003f8

config SERIAL_INPUT_FIFO
  bool "Enable input FIFO with /tmp/nemu.serial"
  default n
endif # HAS_SERIAL

menuconfig HAS_TIMER
  bool "Enable timer"
  default y

if HAS_TIMER
config RTC_PORT
  depends on HAS_PORT_IO
  hex "Port address of the timer"
  default 0x48

config RTC_MMIO
  hex "MMIO address of the timer"
  default 0xa0000048
endif # HAS_TIMER

menuconfig HAS_KEYBOARD
  bool "Enable keyboard"
  default y

if HAS_KEYBOARD
config I8042_DATA_PORT
  depends on HAS_PORT_IO
  hex "Port address of the keyboard controller"
  default 0x60

config I8042_DATA_MMIO
  hex "MMIO address of the keyboard controller"
  default 0xa0000060
endif # HAS_KEYBOARD

menuconfig HAS_VGA
  bool "Enable VGA"
  default y

if HAS_VGA
config FB_ADDR
  hex "Physical address of the VGA frame buffer"
  default 0xa1000000

config VGA_CTL_PORT
  depends on HAS_PORT_IO
  hex "Port address of the VGA controller"
  default 0x100

config VGA_CTL_MMIO
  hex "MMIO address of the VGA controller"
  default 0xa0000100

config VGA_SHOW_SCREEN
  bool "Enable SDL SCREEN"
  default y

choice
  prompt "Screen Size"
  default VGA_SIZE_200x150
config VGA_SIZE_200x150
  bool "200 x 150"
config VGA_SIZE_400x300
  bool "400 x 300"
config VGA_SIZE_800x600
  bool "800 x 600"
endchoice
endif # HAS_VGA

menuconfig HAS_AUDIO
  bool "Enable audio"
  default y

if HAS_AUDIO
config SB_ADDR
  hex "Physical address of the audio stream buffer"
  default 0xa1200000

config SB_SIZE
  hex "Size of the audio stream buffer"
  default 0x10000

config AUDIO_CTL_PORT
  depends on HAS_PORT_IO
  hex "Port address of the audio controller"
  default 0x200

config AUDIO_CTL_MMIO
  hex "MMIO address of the audio controller"
  default 0xa0000200
endif # HAS_AUDIO

menuconfig HAS_DISK
  bool "Enable disk"
  default y

if HAS_DISK
config DISK_CTL_PORT
  depends on HAS_PORT_IO
  hex "Port address of the disk controller"
  default 0x300

config DISK_CTL_MMIO
  hex "MMIO address of the disk controller"
  default 0xa0000300

config DISK_IMG_PATH
  string "The path of disk image"
  default ""
endif # HAS_DISK

menuconfig HAS_SDCARD
  bool "Enable sdcard"
  default n

if HAS_SDCARD
config SDCARD_CTL_MMIO
  hex "MMIO address of the sdcard controller"
  default 0xa3000000

config SDCARD_IMG_PATH
  string "The path of sdcard image"
  default ""
endif # HAS_SDCARD

menuconfig HAS_MROM
  bool "Enable mrom"
  default y

if HAS_MROM
config MROM_BASE
  depends on HAS_MROM
  hex "base address of the mrom"
  default 0x20000000
config MROM_SIZE
  depends on HAS_MROM
  hex "base address of the mrom"
  default 0x00001000
endif # HAS_MROM


config HAS_SRAM
   bool "Enable SRAM memory "
   default n

config SRAM_BASE 
  depends on HAS_SRAM
  hex "SRAM base address"
  default 0x0f000000 

config SRAM_SIZE
  depends on HAS_SRAM
  hex "SRAM size"
  default 0x2000

menuconfig HAS_FLASH
  bool "Enable flash"
  default n

if HAS_FLASH
config FLASH_BASE
  depends on HAS_FLASH
  hex "base address of the flash"
  default 0x30000000
config FLASH_SIZE
  depends on HAS_FLASH
  hex "size of the flash"
  default 0x10000000
endif # HAS_FLASH


menuconfig HAS_PSRAM
  bool "Enable psram"
  default n
if HAS_PSRAM
config PSRAM_BASE
  depends on HAS_PSRAM
  hex "base address of the psram"
  default 0x80000000
config PSRAM_SIZE
  depends on HAS_PSRAM
  hex "size of the psram"
  default 0x20000000
endif # HAS_PSRAM

menuconfig HAS_SDRAM
  bool "Enable sdram"
  default n
if HAS_SDRAM
config SDRAM_BASE
  depends on HAS_SDRAM
  hex "size of the sdram"
  default 0xa0000000
config SDRAM_SIZE
  depends on HAS_SDRAM
  hex "size of the sdram"
  default 0x20000000
config SDRAM_ROW_BITS
  depends on HAS_SDRAM
  int "Number of bits for row address"
  default 8192
config SDRAM_COL_BITS
  depends on HAS_SDRAM
  int "Number of bits for column address"
  default 512
config SDRAM_BA_BITS
  depends on HAS_SDRAM
  int "Number of bits for bank address"
  default 2
endif # HAS_SDRAM


menuconfig HAS_UART
  bool "Enable uart"
  default n
if HAS_UART
config UART_BASE
  depends on HAS_UART
  hex "size of the uart"
  default 0x10000000
config UART_SIZE
  depends on HAS_UART
  hex "size of the uart"
  default 0x10
endif # HAS_UART

config HAS_CLINT
   bool "Enable CLINT "
   default n

config CLINT_BASE 
  depends on HAS_CLINT
  hex "CLINT base address"
  default 0x02000000 

config CLINT_SIZE
  depends on HAS_CLINT
  hex "CLINT size"
  default 0x10000


endif # DEVICE
```

## npc/csrc/memory/Kconfig
```kconfig
menu "Memory Configuration"

choice
  prompt "instruction memory base"
  default IMEM_BASE
config IMEM_BASE
  bool "Memory 0x80000000"
config IMEM_MROM_BASE
  bool "Mrom 0x20000000"
config IMEM_FLASH_BASE
  bool "Flash 0x30000000"
endchoice

config MBASE
  hex "Memory base address"
  default 0x20000000 


config MSIZE
  hex "Memory size"
  default 0x00002000 
endmenu #MEMORY
```
