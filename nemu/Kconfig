## nemu/Kconfig
```kconfig
mainmenu "NEMU Configuration Menu"

choice
  prompt "Base ISA"
  default ISA_riscv
config ISA_x86
  bool "x86"
config ISA_mips32
  bool "mips32"
config ISA_riscv
  bool "riscv"
config ISA_loongarch32r
  bool "loongarch32r"
endchoice

config ISA
  string
  default "x86" if ISA_x86
  default "mips32" if ISA_mips32
  default "riscv32" if ISA_riscv && !RV64
  default "riscv64" if ISA_riscv &&  RV64
  default "loongarch32r" if ISA_loongarch32r
  default "none"

config ISA64
  depends on ISA_riscv && RV64
  bool
  default y


if ISA_riscv
source "src/isa/riscv32/Kconfig"
endif

choice
  prompt "NEMU execution engine"
  default ENGINE_INTERPRETER

config ENGINE_INTERPRETER
  bool "Interpreter"
  help
    Interpreter guest instructions one by one.
endchoice

config ENGINE
  string
  default "interpreter" if ENGINE_INTERPRETER
  default "none"

choice
  prompt "Running mode"
  default MODE_SYSTEM

config MODE_SYSTEM
  bool "System mode"
  help
    Support full-system functionality, including privileged instructions, MMU and devices.
endchoice

choice
  prompt "Build target"
  default TARGET_NATIVE_ELF
config TARGET_NATIVE_ELF
  bool "Executable on Linux Native"
config TARGET_SHARE
  bool "Shared object (used as REF for differential testing)"
config TARGET_AM
  bool "Application on Abstract-Machine (DON'T CHOOSE)"
endchoice

menu "Build Options"
choice
  prompt "Compiler"
  default CC_GCC
config CC_GCC
  bool "gcc"
config CC_GPP
  bool "g++"
config CC_CLANG
  depends on !TARGET_AM
  bool "clang"
endchoice

config CC
  string
  default "gcc" if CC_GCC
  default "g++" if CC_GPP
  default "clang" if CC_CLANG
  default "none"

choice
  prompt "Optimization Level"
  default CC_O2
config CC_O0
  bool "O0"
config CC_O1
  bool "O1"
config CC_O2
  bool "O2"
config CC_O3
  bool "O3"
endchoice

config CC_OPT
  string
  default "-O0" if CC_O0
  default "-O1" if CC_O1
  default "-O2" if CC_O2
  default "-O3" if CC_O3
  default "none"

config CC_LTO
  depends on !TARGET_AM
  bool "Enable link-time optimization"
  default n

config CC_DEBUG
  bool "Enable debug information"
  default n

config CC_ASAN
  depends on MODE_SYSTEM
  bool "Enable address sanitizer"
  default n
endmenu

menu "Testing and Debugging"


config TRACE
  bool "Enable tracer"
  default y

config TRACE_START
  depends on TRACE
  int "When tracing is enabled (unit: number of instructions)"
  default 0

config TRACE_END
  depends on TRACE
  int "When tracing is disabled (unit: number of instructions)"
  default 10000

config PC_TRACE
  depends on TRACE
  bool "Enable PC tracer"
  default n

config BTRACE
  depends on TRACE
  bool "Enable Branch tracer"
  default n


config PC_TRACE_BINARY
  depends on PC_TRACE
  bool "PC Tracer Use Binary Format"
  default y
config PC_TRACE_COMPRESS
  depends on PC_TRACE
  bool "Enable PC Tracer Compress"
  default y


config ITRACE
  depends on TRACE && TARGET_NATIVE_ELF && ENGINE_INTERPRETER
  bool "Enable instruction tracer"
  default n

config ITRACE_COND
  depends on ITRACE
  string "Only trace instructions when the condition is true"
  default "true"

config ETRACE
  depends on TRACE
  bool "Enable ecall tracer"
  default n

 config MTRACE
  depends on TRACE
  bool "Enable memory tracer"
  default n

config MTRACE_RANGE_COND
  depends on MTRACE
  bool "Only track the specified range of memory"
  default y

config MTRACE_RANGE_MIN
  depends on MTRACE_RANGE_COND
  hex "Minimum value of the tracked memory address"
  default "0x80000000"

config MTRACE_RANGE_MAX
  depends on MTRACE_RANGE_COND
  hex "Maximum value of  the tracked memory address"
  default "0x88000000"

config DIFFTEST
  depends on TARGET_NATIVE_ELF
  bool "Enable differential testing"
  default n
  help
    Enable differential testing with a reference design.
    Note that this will significantly reduce the performance of NEMU.

choice
  prompt "Reference design"
  default DIFFTEST_REF_SPIKE if ISA_riscv
  default DIFFTEST_REF_KVM if ISA_x86
  default DIFFTEST_REF_QEMU
  depends on DIFFTEST
config DIFFTEST_REF_QEMU
  bool "QEMU, communicate with socket"
if ISA_riscv
config DIFFTEST_REF_SPIKE
  bool "Spike"
endif
if ISA_x86
config DIFFTEST_REF_KVM
  bool "KVM"
endif
endchoice

config DIFFTEST_REF_PATH
  string
  default "tools/qemu-diff" if DIFFTEST_REF_QEMU
  default "tools/kvm-diff" if DIFFTEST_REF_KVM
  default "tools/spike-diff" if DIFFTEST_REF_SPIKE
  default "none"

config DIFFTEST_REF_NAME
  string
  default "qemu" if DIFFTEST_REF_QEMU
  default "kvm" if DIFFTEST_REF_KVM
  default "spike" if DIFFTEST_REF_SPIKE
  default "none"
endmenu

if MODE_SYSTEM
source "src/memory/Kconfig"
source "src/device/Kconfig"
endif


menu "Miscellaneous"
choice
  depends on !TARGET_AM
  prompt "Host timer"
  default TIMER_GETTIMEOFDAY
config TIMER_GETTIMEOFDAY
  bool "gettimeofday"
config TIMER_CLOCK_GETTIME
  bool "clock_gettime"
endchoice

config RT_CHECK
  bool "Enable runtime checking"
  default y

endmenu

menu "SoC DiffTest Configuration"
depends on TARGET_SHARE

config SOC_DIFFTEST
  bool "Used as REF for differential testing for SoC"
  default n

choice
  prompt "Boot from FLAH or MROM"
  depends on SOC_DIFFTEST
  default BOOT_FLASH
  config BOOT_FLASH
    bool "Boot from FLASH"
  config BOOT_MROM
    bool "Boot from MROM"
endchoice

config MROMBASE
  hex "MROM base address"
  default 0x20000000
config MROMSIZE
  hex "MROM size"
  default 0x1000

config FLASHBASE
  hex "FLASH base address"
  default 0x30000000

config FLASHSIZE
  hex "FLASH size"
  default 0x1000000

config SRAMBASE
  hex "SRAM base address"
  default 0x0f000000
config SRAMSIZE
  hex "SRAM size"
  default 0x2000

config PSRAMBASE
  hex "PSRAM base address"
  default 0x80000000
config PSRAMSIZE
  hex "PSRAM size"
  default 0x400000

config SDRAMBASE
  hex "SDRAM base address"
  default 0xa0000000
config SDRAMSIZE
  hex "SDRAM size"
  default 0x4000000


endmenu
```

## nemu/configs/loongarch32r-am_defconfig
```kconfig
CONFIG_ISA_loongarch32r=y
CONFIG_TARGET_AM=y
# CONFIG_TRACE is not set
CONFIG_MSIZE=0x2000000
CONFIG_DEVICE=y
```

## nemu/configs/riscv32-ysyxsoc_defconfig
```kconfig
CONFIG_RVE=y
# CONFIG_ITRACE is not set
CONFIG_MBASE=0x30000000
# CONFIG_MEM_RANDOM is not set
CONFIG_YSYXSOC=y
CONFIG_HAS_MROM=y
CONFIG_HAS_SRAM=y
CONFIG_HAS_PSRAM=y
CONFIG_HAS_FLASH=y
CONFIG_HAS_SDRAM=y
CONFIG_HAS_UART=y
CONFIG_HAS_CLINT=y
```

## nemu/configs/riscv32_rt_defconfig
```kconfig
# CONFIG_ITRACE is not set
CONFIG_HAS_MROM=y
CONFIG_HAS_SRAM=y
CONFIG_HAS_PSRAM=y
CONFIG_HAS_FLASH=y
CONFIG_HAS_SDRAM=y
CONFIG_HAS_UART=y
CONFIG_HAS_CLINT=y
CONFIG_DEVICE=y
```

## nemu/configs/riscv64-pa_defconfig
```kconfig
CONFIG_PA=y
CONFIG_RV64=y
# CONFIG_RVFD is not set
CONFIG_CC_CLANG=y
CONFIG_CC_O3=y
CONFIG_CC_LTO=y
# CONFIG_TRACE is not set
CONFIG_PC_RESET_OFFSET=0x0
CONFIG_DEVICE=y
# CONFIG_RT_CHECK is not set
CONFIG_TCACHE_SIZE=65536
CONFIG_BB_LIST_SIZE=8192
CONFIG_BB_POOL_SIZE=8192
```

## nemu/configs/riscv64-ref_defconfig
```kconfig
CONFIG_RV64=y
# CONFIG_RVFD is not set
CONFIG_TARGET_SHARE=y
CONFIG_CC_CLANG=y
CONFIG_CC_O3=y
CONFIG_CC_LTO=y
# CONFIG_TRACE is not set
CONFIG_MSIZE=0x80000000
CONFIG_PMEM_MALLOC=y
# CONFIG_MEM_RANDOM is not set
# CONFIG_RT_CHECK is not set
# CONFIG_PERF_OPT is not set
```

## npc/config/Kconfig
```kconfig
mainmenu "ysyxSOC Configuration Menu"

choice
	prompt "Select ROM Type"
	default FLASH if FLASH_AVAILABLE
	default MROM if MROM_AVAILABLE
	config FLASH
		bool "Flash: 0x30000000 - 0x3fffffff"
		help
			Flash: 	Total Storage: 		0x3000_0000 - 0x3fff_ffff, 256MB
					Available Storage:	0x3000_0000 - 0x30ff_ffff, 16MB
			Note: Modify $AM_HOME/am/src/riscv/ysyxsoc/linker.ld to apply Flash!
	config MROM
		bool "MROM:  0x20000000 - 0x20000fff"
		help
			MROM:  	Total Storage:      0x2000_0000 - 0x2000_0fff, 4KB
					Available Storage:  0x2000_0000 - 0x2000_0fff, 4KB
			Note: Modify $AM_HOME/am/src/riscv/ysyxsoc/linker.ld to apply MROM!

endchoice

config FLASH_AVAILABLE
	bool
	default y
config MROM_AVAILABLE
	bool
	default n

choice
	prompt "Flash Access Mode"
	depends on FLASH
	default XIP if XIP_AVAILABLE
	default FAST_FLASH if FAST_FLASH_AVAILABLE
	config XIP
		bool "eXecute In Place(SPI)"
	config FAST_FLASH
		bool "Fast Access(non-SPI)"
endchoice

config XIP_AVAILABLE
	bool
	default y
config FAST_FLASH_AVAILABLE
	bool
	default n

choice
	prompt "Select RAM Type"
	#default SRAM if SRAM_AVAILABLE
	default PSRAM if PSRAM_AVAILABLE
	default SDRAM if SDRAM_AVAILABLE
	#config SRAM
		#bool "SRAM:  0x0f000000 - 0x0f001fff"
		#help
		#	SRAM:  	Total Storage:      0x0f00_0000 - 0x0f00_1fff, 8KB
		#			Available Storage:  0x0f00_0000 - 0x0f00_1fff, 8KB
		#	Note: Modify $AM_HOME/am/src/riscv/ysyxsoc/linker.ld to apply SRAM!
	config PSRAM
		bool "PSRAM: 0x80000000 - 0x803fffff"
		help
			PSRAM:  Total Storage:      0x8000_0000 - 0x9fff_ffff, 512MB
					Available Storage:  0x8000_0000 - 0x803f_ffff, 4MB
			Note: Modify $AM_HOME/am/src/riscv/ysyxsoc/linker.ld to apply PSRAM!
	config SDRAM
		bool "SDRAM: 0xa0000000 - 0xa1ffffff"
		help
			SDRAM:  Total Storage:      0xa000_0000 - 0xbfff_ffff, 512MB
					Available Storage:  0xa000_0000 - 0xa1ff_ffff, 32MB
			Note: Modify $AM_HOME/am/src/riscv/ysyxsoc/linker.ld to apply SDRAM!
endchoice


#config SRAM_AVAILABLE
#	bool
#	default n
config PSRAM_AVAILABLE
	bool 
	default y
config SDRAM_AVAILABLE
	bool
	default n



config ICACHE
    bool "Icache Configuration"
    default y
	help
      This option enables the ICache configuration menu.
 
 
config N
   	int "ICache Parameter N (block num = 2^N)"
   	range 1 10
   	default 3
   	depends on ICACHE
	help
		Bit width for index(num of blocks). Valid values are 2, 3, 4, and 5.
 
config M
    int "ICache Parameter M (block size = 2^M)"
    range 2 10
    default 4
    depends on ICACHE
	help
		Bit width for offset(block size). Valid values are 2, 3, 4, and 5.




#config DEVICES
#	bool "Devices"
#	default y

#if DEVICES
#menu "Device Configuration"

#config SERIAL
#	bool "Serial"
#	default y
#	depends on DEVICES
#config TIMER
#	bool "Timer"
#	default y
#	depends on DEVICES
#config KEYBOARD
#	bool "Keyboard"
#	default y
#	depends on DEVICES
#config GPU
#	bool "GPU"
#	default y
#	depends on DEVICES

#endmenu
#endif


config CALIB_AXI4
	bool "Calibration of Memory Access(AXI4)"
	default y

config CALIB_APB
    bool "Calibration of Memory Access(APB)"
    default y

config STAT
    bool "Enable Statistics"
    default y

config WAVEREC
	bool "Enable Wave Record"
	default y

config NVBOARD
	bool "Enable Nvboard"
	default y

config SDB
	bool "Enable SDB"
	default y

config PRINT_INST
	bool "Print instructions"
	default y
	depends on SDB
config MAX_NO_INST
	int "Max number of inst to print"
	range 5 50
	default 10
	depends on PRINT_INST

config ITRACE
	bool "Enable Itrace"
	default y
config MTRACE
	bool "Enable Mtrace"
	default y
config DTRACE
	bool "Enable Dtrace"
	default y
config FTRACE
	bool "Enable Ftrace"
	default y
config ETRACE
	bool "Enable Etrace"
	default y
	
config WP
	bool "Enable Watchpoint"
	default y
```

## npc/configs/riscv32e-iverilog_defconfig
```kconfig
CONFIG_NPC_CHISEL=y
CONFIG_IVERILOG=y
# CONFIG_SOC is not set
# CONFIG_TRACE is not set
CONFIG_DEVICE=y
# CONFIG_HAS_KEYBOARD is not set
# CONFIG_HAS_VGA is not set
# CONFIG_HAS_AUDIO is not set
# CONFIG_HAS_DISK is not set
# CONFIG_HAS_MROM is not set
CONFIG_HAS_CLINT=y
CONFIG_MBASE=0x80000000
CONFIG_MSIZE=0x8000000
```

## npc/configs/riscv32e-ysyxsoc_defconfig
```kconfig
CONFIG_NPC_CHISEL=y
CONFIG_NVBOARD=y
# CONFIG_TRACE is not set
CONFIG_DEVICE=y
# CONFIG_HAS_SERIAL is not set
# CONFIG_HAS_TIMER is not set
# CONFIG_HAS_KEYBOARD is not set
# CONFIG_HAS_VGA is not set
# CONFIG_HAS_AUDIO is not set
# CONFIG_HAS_DISK is not set
CONFIG_HAS_SRAM=y
CONFIG_HAS_FLASH=y
CONFIG_HAS_PSRAM=y
CONFIG_HAS_SDRAM=y
CONFIG_SDRAM_BA_BITS=4
CONFIG_HAS_UART=y
CONFIG_HAS_CLINT=y
CONFIG_IMEM_FLASH_BASE=y
CONFIG_MBASE=0x30000000
CONFIG_MSIZE=0x8000000
```
